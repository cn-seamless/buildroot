## package/oniguruma/Config.in.host
```kconfig
config BR2_PACKAGE_HOST_ONIGURUMA
	bool "host oniguruma"
	help
	  Oniguruma is a modern and flexible regular expressions
	  library. It encompasses features from different regular
	  expression implementations that traditionally exist in
	  different languages.

	  https://github.com/kkos/oniguruma
```
